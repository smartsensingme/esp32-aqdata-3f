## main/Kconfig.projbuild
```kconfig
menu "Application control"

config APP_CONTROL_LIMIT_MV
    int "Controller command limit in software millivolts"
    range 1 6000
    default 6000
    help
        Symmetric limit before mapping the +/-6 V software range to DAC codes.
        6000 uses the full DAC code range 0..4095. Smaller values explicitly
        restrict the actuator range; the application default has no reduced
        commissioning ceiling.
        This is a software scale, not a measurement of voltage/current at the
        coil. PR and integral share the full range without fixed reserves.

config APP_OFFSET_CAL_GPIO
    int "Active-low startup offset calibration GPIO"
    range 7 18
    default 7
    help
        Input with internal pull-up, sampled only during startup. Connect to
        ground during reset to measure and persist all three ADC offsets.
        All three phases must have zero physical error. The DAC stays at midpoint
        until calibration and NVS commit finish. Release before the next reset
        to reuse the stored record. Choose an unused, board-accessible GPIO;
        MCP4922 pin conflicts are rejected at startup.

config APP_PR_TRACKING_TIME_US
    int "Anti-windup tracking time (microseconds; 0 disables)"
    range 0 10000000
    default 10000
    help
        Common post-sample tracking time for the summed PR+I output.
        Component-local corrections are disabled in this coordinator.
        The initial 10 ms
        value is provisional and must be validated with the physical plant.
        Smaller values produce stronger state correction during saturation.
        Zero reproduces the linear controller with output limiting only.

config APP_RMS_LOG_ENABLE
    bool "Print RMS values to the console"
    default y
    help
        Print three-phase compensation DC/total RMS every 10 seconds and
        detailed phase R ADC/FIR population statistics every 60 seconds.
        Each capture contains 100 ms of samples. Formatting runs on Core 0;
        disabling output preserves acquisition, capture and calculations.

endmenu
```
